## companion_firmware/main/Kconfig.projbuild
```kconfig
menu "AI Companion firmware"

    config COMPANION_SERVER_BASE_URL
        string "Default Mac service base URL"
        default "http://xiaolonzdeMacBook-Pro.local:8765"
        help
            This address is prefilled in the Wi-Fi setup page. Bonjour/mDNS
            keeps it stable when this Mac receives a different LAN IP address.
            Enter the service root only, without /repeat or /voice-chat.

    config COMPANION_API_TOKEN
        string "Optional server API token"
        default ""
        help
            When non-empty, requests include this value as a Bearer token.
            Leave it empty for the convenient trusted-home-network setup.

    config COMPANION_CHAT_RECORD_SECONDS
        int "Maximum chat recording length in seconds"
        range 2 20
        default 8

    config COMPANION_SPEAKER_VOLUME
        int "Speaker volume"
        range 1 100
        default 75

    menu "Dictation defaults"

        config COMPANION_DICTATION_UNIT_ID
            string "Default knowledge unit ID"
            default "pep-cn-g3-s1:u1"

        config COMPANION_DICTATION_MODE
            string "Default dictation mode"
            default "chinese_word"

        config COMPANION_DICTATION_COUNT
            int "Default number of dictation items"
            range 1 100
            default 10

        config COMPANION_DICTATION_WAIT_SECONDS
            int "Seconds before automatically advancing"
            range 3 60
            default 10

        config COMPANION_COMMAND_MAX_SECONDS
            int "Maximum spoken-command recording length in seconds"
            range 1 8
            default 3

    endmenu

    menu "Voice activity detection"

        config COMPANION_VAD_ENERGY_THRESHOLD
            int "Average absolute PCM energy threshold"
            range 100 20000
            default 900
            help
                A frame whose mean absolute PCM16 amplitude reaches this
                value is treated as speech. Raise it in a noisy room.

        config COMPANION_VAD_END_SILENCE_MS
            int "Silence needed to finish a command (ms)"
            range 200 2000
            default 650

        config COMPANION_VAD_PRE_ROLL_MS
            int "Audio retained before speech begins (ms)"
            range 0 1000
            default 200

    endmenu

    menu "BOOT button timing"

        config COMPANION_BUTTON_DEBOUNCE_MS
            int "Debounce duration (ms)"
            range 10 100
            default 30

        config COMPANION_BUTTON_CHAT_HOLD_MS
            int "Hold duration that starts chat recording (ms)"
            range 200 1500
            default 350

    endmenu

endmenu
```

## companion_firmware/sdkconfig.defaults
```kconfig
CONFIG_ESPTOOLPY_FLASHMODE_DIO=y
CONFIG_ESPTOOLPY_FLASHFREQ_40M=y
CONFIG_ESPTOOLPY_FLASHSIZE_16MB=y
CONFIG_ESP_CONSOLE_SECONDARY_USB_SERIAL_JTAG=y

# The animated RGB565 eye is compiled into the application. Reserve a 4 MB
# factory partition instead of ESP-IDF's 1 MB single-app default.
CONFIG_PARTITION_TABLE_CUSTOM=y
CONFIG_PARTITION_TABLE_CUSTOM_FILENAME="partitions.csv"

# The central C++ state machine nests HTTP/cJSON work with dictation state and
# audio frame buffers. Give app_main enough headroom beyond IDF's 3.5 KB default.
CONFIG_ESP_MAIN_TASK_STACK_SIZE=12288

# The Zhengchen EYE board has 16 MB octal PSRAM. Audio request/response
# buffers and the LCD frame buffer are allocated there.
CONFIG_SPIRAM=y
CONFIG_SPIRAM_MODE_OCT=y
CONFIG_SPIRAM_SPEED_80M=y
CONFIG_SPIRAM_USE_MALLOC=y
CONFIG_SPIRAM_MALLOC_ALWAYSINTERNAL=512
CONFIG_SPIRAM_MALLOC_RESERVE_INTERNAL=65536

# Resolve the configured Mac .local name without pinning its LAN IP.
CONFIG_LWIP_DNS_SUPPORT_MDNS_QUERIES=y

CONFIG_CODEC_ES8311_SUPPORT=y
CONFIG_CODEC_ES7210_SUPPORT=y
```

## eye_demo/sdkconfig.defaults
```kconfig
CONFIG_ESPTOOLPY_FLASHMODE_DIO=y
CONFIG_ESPTOOLPY_FLASHFREQ_40M=y
CONFIG_ESPTOOLPY_FLASHSIZE_16MB=y
CONFIG_ESP_CONSOLE_SECONDARY_USB_SERIAL_JTAG=y
```

## hello_world/sdkconfig.defaults
```kconfig
CONFIG_ESPTOOLPY_FLASHMODE_DIO=y
CONFIG_ESPTOOLPY_FLASHFREQ_40M=y
CONFIG_ESPTOOLPY_FLASHSIZE_16MB=y
```

## repeater_demo/main/Kconfig.projbuild
```kconfig
menu "Zhengchen repeater demo"

    config REPEATER_SERVER_URL
        string "Default Mac /repeat URL"
        default "http://ai-companion-mac.local:8765/repeat"
        help
            This is prefilled on the setup page. Bonjour avoids changing the
            ESP configuration when the Mac gets a different LAN IP.

    config REPEATER_RECORD_SECONDS
        int "Maximum recording length in seconds"
        range 2 20
        default 8

    config REPEATER_SPEAKER_VOLUME
        int "Speaker volume"
        range 1 100
        default 75

endmenu
```

## repeater_demo/sdkconfig.defaults
```kconfig
CONFIG_ESPTOOLPY_FLASHMODE_DIO=y
CONFIG_ESPTOOLPY_FLASHFREQ_40M=y
CONFIG_ESPTOOLPY_FLASHSIZE_16MB=y
CONFIG_ESP_CONSOLE_SECONDARY_USB_SERIAL_JTAG=y

# Zhengchen EYE uses octal PSRAM. Recordings and TTS replies are kept there.
CONFIG_SPIRAM=y
CONFIG_SPIRAM_MODE_OCT=y
CONFIG_SPIRAM_SPEED_80M=y
CONFIG_SPIRAM_USE_MALLOC=y
CONFIG_SPIRAM_MALLOC_ALWAYSINTERNAL=512
CONFIG_SPIRAM_MALLOC_RESERVE_INTERNAL=65536

CONFIG_LWIP_DNS_SUPPORT_MDNS_QUERIES=y
CONFIG_CODEC_ES8311_SUPPORT=y
CONFIG_CODEC_ES7210_SUPPORT=y
```
